## CMakeLists.txt
```
cmake_minimum_required(VERSION 3.20.0)

# Pull in the Zephyr build system dynamically using ZEPHYR_BASE
find_package(Zephyr REQUIRED HINTS $ENV{ZEPHYR_BASE})

project(pcie_audio)

# Application source files
target_sources(app PRIVATE src/main.c)
```

## prj.conf
```kconfig
### C Library & Floating-Point Support (for audio processing math)

# Use Newlib as the C library implementation.
CONFIG_NEWLIB_LIBC=y

# Enable floating-point formatting in Zephyr's cbprintf routines.
CONFIG_CBPRINTF_FP_SUPPORT=y

### Zephyr PCIe Core Subsystem

# Enable Zephyr's PCI/PCIe subsystem.
CONFIG_PCIE=y

# Enable PCIe controller management for the host controller.
CONFIG_PCIE_CONTROLLER=y

# Build the ECAM driver used by the board's generic PCIe host.
CONFIG_PCIE_ECAM=y

# Enable Message Signaled Interrupt support for PCIe devices.
CONFIG_PCIE_MSI=y

# Allow a PCIe device to use multiple MSI interrupt vectors.
CONFIG_PCIE_MSI_MULTI_VECTOR=y

# Enable the GICv3 Interrupt Translation Service used to route PCIe MSIs.
CONFIG_GIC_V3_ITS=y

# Reserve 1 MiB of heap for dynamically allocated ITS tables and related data.
CONFIG_HEAP_MEM_POOL_SIZE=1048576

### Logging Subsystem
# Enable Zephyr logging.
CONFIG_LOG=y

# Emit log messages immediately instead of buffering them.
CONFIG_LOG_MODE_IMMEDIATE=y

# Send startup and runtime log messages directly to the UART console.
CONFIG_LOG_BACKEND_UART=y

# Avoid duplicate messages through the shell's later-starting log backend.
CONFIG_SHELL_LOG_BACKEND=n

### Interactive Shell
# Enable the Zephyr command shell.
CONFIG_SHELL=y

# Add PCIe inspection and management commands to the shell.
CONFIG_PCIE_SHELL=y
```

## src/main.c
```c
#include <zephyr/kernel.h>
#include <zephyr/logging/log.h>
#include <zephyr/drivers/pcie/pcie.h>

LOG_MODULE_REGISTER(pcie_audio_app, LOG_LEVEL_INF);

#define AUDIO_SAMPLE_RATE_HZ   48000
#define AUDIO_FRAME_SAMPLES    1024
#define AUDIO_FRAME_SIZE_BYTES (AUDIO_FRAME_SAMPLES * sizeof(int16_t))
#define FRAME_DEADLINE_US      21330 /* 21.33 ms */

int main(void)
{
    LOG_INF("==================================================");
    LOG_INF("  Real-Time PCIe Audio Streaming POC");
    LOG_INF("  Target: qemu_cortex_a53 | OS: Zephyr RTOS");
    LOG_INF("==================================================");
    LOG_INF("Spec: 48 kHz, 16-bit PCM, 1024 samples/frame (%zu bytes)",
            AUDIO_FRAME_SIZE_BYTES);
    LOG_INF("Processing Deadline: %u us (%u.%02u ms)",
            FRAME_DEADLINE_US, FRAME_DEADLINE_US / 1000, (FRAME_DEADLINE_US % 1000) / 10);
    LOG_INF("--------------------------------------------------");
    LOG_INF("System Initialized.");

    return 0;
}
```
